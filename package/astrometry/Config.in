## package/astrometry/Config.in
```kconfig
config BR2_PACKAGE_ASTROMETRY
       bool "astrometry"
       select BR2_PACKAGE_ZLIB
       select BR2_PACKAGE_JPEG
       select BR2_PACKAGE_PYTHON
       select BR2_PACKAGE_NETPBM
       select BR2_PACKAGE_CFITSIO
       help
        astrometry Star Tracking Software

choice
    prompt "astrometry version"
    depends on BR2_PACKAGE_ASTROMETRY
    default BR2_PACKAGE_ASTROMETRY_version_head
    help
        The git version (tag) to use
    config BR2_PACKAGE_ASTROMETRY_version_head
           bool "HEAD"

    config BR2_PACKAGE_ASTROMETRY_version_custom
           bool "Custom version"

endchoice

config BR2_PACKAGE_ASTROMETRY_CONFIG_CUSTOM_VERSION_STR
       string "astrometry version (tag)" 
       depends on BR2_PACKAGE_ASTROMETRY
       depends on BR2_PACKAGE_ASTROMETRY_version_custom
       help
        Specify a git tag to use for building
```

## package/cfitsio/Config.in
```kconfig
config BR2_PACKAGE_CFITSIO
       bool "cfitsio"
       help
        cfitsio C FITS i/o librar
        
```

## package/irvinecubesat/Config.in
```kconfig
menu "Irvine Cubesat Packages"

#
# Start off with one package to minimize buildroot churn.  As we develop
# reusable components or need more customizability we can split into multiple
# packages
# 
#
source "package/irvinecubesat/irv01/Config.in"

endmenu
```

## package/irvinecubesat/irv01/Config.in
```kconfig
config BR2_PACKAGE_IRV01
       bool "irv01"
       select BR2_PACKAGE_LIBSATPKT
       select BR2_PACKAGE_LIBPROC
       select BR2_PACKAGE_LIBGPIO
       help
        irvine 01 software package

        http://github/irvinecubesat/irvine-01-sw

choice
    prompt "irv01 version"
    depends on BR2_PACKAGE_IRV01
    default BR2_PACKAGE_IRV01_version_head
    help
        The git version (tag) to use
    config BR2_PACKAGE_IRV01_version_head
           bool "HEAD"

    config BR2_PACKAGE_IRV01_version_custom
           bool "Custom version"

endchoice

config BR2_PACKAGE_IRV01_CONFIG_CUSTOM_VERSION_STR
       string "irvine-01-sw version (tag)" 
       depends on BR2_PACKAGE_IRV01
       depends on BR2_PACKAGE_IRV01_version_custom
       help
        Specify a git tag to use for building
```

## package/python-d2to1/Config.in
```kconfig
config BR2_PACKAGE_PYTHON_D2TO1
	bool "python-d2to1"
	depends on BR2_PACKAGE_PYTHON
	select BR2_PACKAGE_PYTHON_ZLIB
	help
	  Download, build, install, upgrade, and uninstall Python packages.

	  http://pypi.python.org/pypi/setuptools
```

## package/python-pyfits/Config.in
```kconfig
config BR2_PACKAGE_PYTHON_PYFITS
	bool "python-pyfits"
    depends on BR2_PACKAGE_PYTHON
	help
	  Pyfits reads fits images and tables into numpy arrays and manipulates FITS headers
	  with Python.

	  https://pypi.python.org/pypi/pyfits/3.4
```

## package/python-stsci-distutils/Config.in
```kconfig
config BR2_PACKAGE_PYTHON_STSCI_DISTUTILS
	bool "python-stsci-distutils"
	depends on BR2_PACKAGE_PYTHON
	select BR2_PACKAGE_PYTHON_ZLIB
	help
	  Download, build, install, upgrade, and uninstall Python packages.

	  http://pypi.python.org/pypi/setuptools
```
